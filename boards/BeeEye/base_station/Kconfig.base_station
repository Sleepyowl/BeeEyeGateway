## boards/BeeEye/base_station/Kconfig.base_station
```kconfig
# ESP32C6 devkitc board configuration

# Copyright (c) 2024 Espressif Systems (Shanghai) Co., Ltd.
# SPDX-License-Identifier: Apache-2.0

config BOARD_BASE_STATION
	select SOC_ESP32_C6_WROOM_1U_N8
	select SOC_ESP32C6_HPCORE if BOARD_BASE_STATION_ESP32C6_HPCORE
	select SOC_ESP32C6_LPCORE if BOARD_BASE_STATION_ESP32C6_LPCORE
```

## boards/BeeEye/base_station/board.yml
```yaml
board:
  name: base_station
  full_name: BeeEye LoRa Base Station
  vendor: BeeEye
  socs:
  - name: esp32c6
```
